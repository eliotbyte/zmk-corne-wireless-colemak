#include <input/processors.dtsi>
#include <dt-bindings/zmk/input_transform.h>

/ {
    /*
     * Avoid ZMK build failure with multiple temp-layer instances
     * (zmkfirmware/zmk#3282):
     * The shield module already defines a temp-layer processor (`auto_mouse_layer`)
     * in its `split_input_common.dtsi`. We delete it and use ONLY the pre-defined
     * `zip_temp_layer` instance.
     */
    /delete-node/ auto_mouse_layer;
};

&trackball_listener {
    /* Module's split_input_common.dtsi defines:
     *   move { input-processors = <&auto_mouse_layer ...>; }
     * If we delete `auto_mouse_layer`, we must also delete the `move` node
     * (otherwise devicetree fails with undefined node label).
     */
    /delete-node/ move;

    // mouse_layer = 2, scroll_layer = 6, mouse_shift_layer = 7 (from config/charybdis.keymap)
    input-processors = <&zip_temp_layer 2 850 &zip_xy_scaler 6 5>;

    slow_pointer {
        layers = <7>;
        input-processors = <&zip_temp_layer 2 850 &zip_xy_scaler 3 5>;
    };

    scroller {
        layers = <6>;
        input-processors = <&zip_xy_to_scroll_mapper
            &zip_scroll_scaler 5 48
            &zip_scroll_transform (INPUT_TRANSFORM_Y_INVERT)
        >;
    };
};

&zip_temp_layer {
    require-prior-idle-ms = <150>;
};

