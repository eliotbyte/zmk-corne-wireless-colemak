/*
 * Copyright (c) 2020 Pete Johanson
 *
 * SPDX-License-Identifier: MIT
 */

#include "corne_split_common.dtsi"

/ {
    chosen {
        /delete-property/ zephyr,display;
        zmk,kscan = &mock_kscan;
    };

    /* corne_split_common.dtsi leaves gpio-matrix kscan without col-gpios; dongle uses mock only */
    /delete-node/ kscan;

    mock_kscan: kscan_mock {
        compatible = "zmk,kscan-mock";
        columns = <0>;
        rows = <0>;
        events = <0>;
    };
};

&pro_micro_i2c {
    status = "disabled";
};
