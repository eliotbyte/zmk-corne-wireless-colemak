## config/boards/shields/corne_wireless/Kconfig.shield
```kconfig
# SPDX-License-Identifier: MIT

config SHIELD_CORNE_DONGLE
    def_bool $(shields_list_contains,corne_dongle)

config SHIELD_CORNE_LEFT_PERIPHERAL
    def_bool $(shields_list_contains,corne_left_peripheral)

config SHIELD_CORNE_RIGHT_PERIPHERAL
    def_bool $(shields_list_contains,corne_right_peripheral)
```

## config/boards/shields/zmk_reset/Kconfig.defconfig
```kconfig
# SPDX-License-Identifier: MIT

if SHIELD_ZMK_RESET

config ZMK_KEYBOARD_NAME
	default "zmk_reset"

endif
```

## config/boards/shields/zmk_reset/Kconfig.shield
```kconfig
# SPDX-License-Identifier: MIT

config SHIELD_ZMK_RESET
	def_bool $(shields_list_contains,zmk_reset)
```

## config/west.yml
```yaml
manifest:
  remotes:
    - name: zmkfirmware
      url-base: https://github.com/zmkfirmware
    - name: alexrorsh
      url-base: https://github.com/alexrorsh
    - name: badjeff
      url-base: https://github.com/badjeff
  projects:
    - name: zmk
      remote: zmkfirmware
      revision: 4ec69cb
      import: app/west.yml
    - name: charybdis-3-6-dongle-prospector-studio
      remote: alexrorsh
      revision: fa48c4d248f6c88c84e7b62bdf076af5ceeafb34
    - name: zmk-pmw3610-driver
      remote: badjeff
      revision: 77635ba
  self:
    path: config
```
